## config/boards/shields/siguro/Kconfig.shield
```kconfig
# Copyright (c) 2020 Pete Johanson
# SPDX-License-Identifier: MIT

config SHIELD_SIGURO_LEFT
	def_bool $(shields_list_contains,siguro_left)

config SHIELD_SIGURO_RIGHT
	def_bool $(shields_list_contains,siguro_right)
```
