/*
 * Copyright (c) 2020 The ZMK Contributors
 *
 * SPDX-License-Identifier: MIT
 */


//Corne
#include "../miryoku/custom_config.h"
#include "../miryoku/mapping/42/corne.h"
#include "../miryoku/miryoku.dtsi"

&nice_view_spi {
   cs-gpios = <&pro_micro 4 GPIO_ACTIVE_HIGH>;
};